## conf/layer.conf
```bitbake
# We have a conf and classes directory, add to BBPATH
BBPATH .= ":${LAYERDIR}"

# We have recipes-* directories, add to BBFILES
BBFILES += "${LAYERDIR}/recipes-*/*/*.bb \
            ${LAYERDIR}/recipes-*/*/*.bbappend"

BBFILE_COLLECTIONS += "meta-deepx-m1"
BBFILE_PATTERN_meta-deepx-m1 = "^${LAYERDIR}/"
BBFILE_PRIORITY_meta-deepx-m1 = "6"

LAYERDEPENDS_meta-deepx-m1 = "core"
LAYERSERIES_COMPAT_meta-deepx-m1 = "scarthgap"
```
